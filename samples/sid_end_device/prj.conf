## prj.conf
```kconfig
#
# Copyright (c) 2023 Nordic Semiconductor ASA
#
# SPDX-License-Identifier: LicenseRef-Nordic-5-Clause
#

# Sidewalk
CONFIG_SIDEWALK=y
CONFIG_SMF=y
CONFIG_SIDEWALK_DFU=n

CONFIG_SIDEWALK_LINK_MASK_FSK=y
#CONFIG_SIDEWALK_LINK_MASK_LORA=y
#CONFIG_RADIO_SX126X=y
CONFIG_RADIO_LR11XX=y
CONFIG_RADIO_TCXO=y
#CONFIG_SMTC_CLI=y
#CONFIG_SIDEWALK_THREAD_QUEUE_SIZE=20
CONFIG_GPIO=y

# Log
CONFIG_LOG=y
CONFIG_LOG_PRINTK=y
CONFIG_LOG_BUFFER_SIZE=2048
CONFIG_NVS_LOG_LEVEL_WRN=y
CONFIG_LOG_MODE_IMMEDIATE=y
CONFIG_CONSOLE=y
CONFIG_USE_SEGGER_RTT=y
CONFIG_LOG_BACKEND_RTT=y

# Bluetooth
CONFIG_BT_DEVICE_NAME="Nordic"

# Power Management
CONFIG_PM_DEVICE=y

# Debug
CONFIG_RESET_ON_FATAL_ERROR=n
CONFIG_SYS_HEAP_RUNTIME_STATS=y
```

## src/main.c
```c
/*
 * Copyright (c) 2023 Nordic Semiconductor ASA
 *
 * SPDX-License-Identifier: LicenseRef-Nordic-5-Clause
 */

#include <app.h>
#include <zephyr/logging/log.h>
#include <sidewalk_version.h>

#include <zephyr/device.h>
#include <zephyr/drivers/gpio.h>

#define RADVCC_NODE DT_ALIAS(radvcc)
#define BUTSIG_NODE DT_ALIAS(butsig)

static const struct gpio_dt_spec radvcc_gpio  = GPIO_DT_SPEC_GET(RADVCC_NODE, gpios);
static const struct gpio_dt_spec butsig_gpio  = GPIO_DT_SPEC_GET(BUTSIG_NODE, gpios);

#include <zephyr/logging/log.h>
LOG_MODULE_REGISTER(main, CONFIG_SIDEWALK_LOG_LEVEL);

int main(void)
{
	gpio_pin_configure_dt(&radvcc_gpio, GPIO_OUTPUT_ACTIVE);
    gpio_pin_set_dt(&radvcc_gpio, 1);
    
    gpio_pin_configure_dt(&butsig_gpio, GPIO_OUTPUT_ACTIVE);
    gpio_pin_set_dt(&butsig_gpio, 1);
	
	PRINT_SIDEWALK_VERSION();

	app_start();

	return 0;
}
```
