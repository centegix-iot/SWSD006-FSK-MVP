## west.yml
```yaml
# Copyright (c) 2021 Nordic Semiconductor ASA
# SPDX-License-Identifier: Apache-2.0

manifest:
  self:
    path: SWSD006-FSK-MVP
    west-commands: scripts/west-commands.yml

  remotes:
    - name: ncs
      url-base: https://github.com/nrfconnect
    - name: centegix-iot
      url-base: https://https://github.com/centegix-iot/

  projects:
    - name: nrf
      remote: ncs
      repo-path: sdk-nrf
      revision: v2.6.1
      import: true
    - name: sidewalk
      remote: centegix-iot
      repo-path: sidewalk
      revision: v2.6.1
    # - name: lbm431
    #   remote: lora-net
    #   repo-path: SWSD006-FSK-MVP
    #   revision: lbm_v431
    # - name: lbm450
    #   remote: lora-net
    #   repo-path: SWSD006-FSK-MVP
    #   revision: lbm_v450
```
